## components/airdrop_bridge/Kconfig
```kconfig
menu "AirDrop bridge"
config AIRDROP_COEX
    bool "ch6 2.4 GHz dual-protocol receive (Wi-Fi STA + AWDL)"
    default n
    help
        Experiment: keep a connected 2.4 GHz station on channel 6 and attach
        AWDL via APSTA so the same radio can receive ordinary Wi-Fi frames and
        AWDL/AirDrop frames together. Requires a router already on channel 6
        (the only 2.4 GHz AWDL channel). HTTP GETs stay up to exercise the
        Wi-Fi path while AirDrop may arrive. Timing is experimental.
endmenu
```
